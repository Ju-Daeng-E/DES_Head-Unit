## backups/emergency_20251126_135018/meta-custom/meta-env/conf/distro/des.conf
```bitbake
DISTRO = "des"
DISTRO_NAME = "DES Head-Unit"
DISTRO_VERSION = "1.0"
VIRTUAL-RUNTIME_init_manager = "systemd"
DISTRO_FEATURES:append = " systemd wayland opengl pulseaudio bluetooth pam usrmerge"
QT_QPA_PLATFORM ?= "wayland"
PACKAGE_CLASSES ?= "package_rpm"
SYSTEMD_DEFAULT_TARGET = "graphical.target"
PACKAGECONFIG:append:pn-systemd = " timesyncd"
ROOT_HOME = "/root"
LICENSE_FLAGS_ACCEPTED:append = " synaptics-killswitch"
INHERIT += "report-error"
```

## build-des/conf/bblayers.conf
```bitbake
# POKY_BBLAYERS_CONF_VERSION is increased each time build/conf/bblayers.conf
# changes incompatibly
POKY_BBLAYERS_CONF_VERSION = "2"

BBPATH = "${TOPDIR}"
BBFILES ?= ""

BBLAYERS ?= " \
  /home/jeongmin/yocto/work/poky/meta \
  /home/jeongmin/yocto/work/poky/meta-poky \
  /home/jeongmin/yocto/work/poky/meta-yocto-bsp \
  /home/jeongmin/yocto/work/meta-openembedded/meta-oe \
  /home/jeongmin/yocto/work/meta-openembedded/meta-python \
  /home/jeongmin/yocto/work/meta-openembedded/meta-networking \
  /home/jeongmin/yocto/work/meta-raspberrypi \
  /home/jeongmin/yocto/work/meta-qt6 \
  /home/jeongmin/yocto/work/meta-custom/meta-env \
  /home/jeongmin/yocto/work/meta-custom/meta-app \
  /home/jeongmin/yocto/work/meta-custom/meta-piracer \
  /home/jeongmin/yocto/work/build-des/workspace \
  "
```
